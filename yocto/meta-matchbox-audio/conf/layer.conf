## yocto/meta-matchbox-audio/conf/layer.conf
```bitbake
# Layer configuration for meta-matchbox-audio.
BBPATH .= ":${LAYERDIR}"

BBFILES += "${LAYERDIR}/recipes-*/*/*.bb \
            ${LAYERDIR}/recipes-*/*/*.bbappend"

BBFILE_COLLECTIONS += "meta-matchbox-audio"
BBFILE_PATTERN_meta-matchbox-audio = "^${LAYERDIR}/"
BBFILE_PRIORITY_meta-matchbox-audio = "7"

LAYERDEPENDS_meta-matchbox-audio = "core multimedia-layer networking-layer pi-base raspberrypi rust-bin-layer"
LAYERSERIES_COMPAT_meta-matchbox-audio = "scarthgap"
```
